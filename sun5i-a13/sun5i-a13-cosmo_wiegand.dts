/dts-v1/;
/plugin/;
 
/ {
	compatible = "allwinner,sun5i-a13";
	
	fragment@0 {
		target-path = "/";
		__overlay__ {
			wiegand: wiegand {
				compatible = "trexom,wiegand";
				wiegand1_input0-gpios = <&pio 1 3 0>;
				wiegand1_input1-gpios = <&pio 1 10 0>;
				wiegand2_input0-gpios = <&pio 6 1 0>;
				wiegand2_input1-gpios = <&pio 6 2 0>;
			};
		};
	};
};